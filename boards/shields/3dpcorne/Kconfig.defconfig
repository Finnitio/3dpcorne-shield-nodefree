## boards/shields/3dpcorne/Kconfig.defconfig
```kconfig
if SHIELD_3DPCORNE_LEFT

config ZMK_KEYBOARD_NAME
    default "3dpcorne"

config ZMK_SPLIT_ROLE_CENTRAL
    default y

endif

if SHIELD_3DPCORNE_LEFT || SHIELD_3DPCORNE_RIGHT

    config ZMK_SPLIT
        default y

endif
```

## boards/shields/3dpcorne/Kconfig.shield
```kconfig
config SHIELD_3DPCORNE_LEFT
    def_bool $(shields_list_contains,3dpcorne_left)

config SHIELD_3DPCORNE_RIGHT
    def_bool $(shields_list_contains,3dpcorne_right)
```
